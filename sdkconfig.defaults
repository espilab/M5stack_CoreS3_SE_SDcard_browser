## sdkconfig.defaults
```kconfig
CONFIG_TINYUSB_NET_MODE_NCM=y
CONFIG_ESP_TASK_WDT_TIMEOUT_S=30
CONFIG_ESP_MAIN_TASK_STACK_SIZE=8192
CONFIG_LWIP_TCPIP_TASK_STACK_SIZE=8192
CONFIG_COMPILER_OPTIMIZATION_DEBUG=y
CONFIG_FATFS_LFN_HEAP=y
CONFIG_FATFS_MAX_LFN=255
CONFIG_FATFS_API_ENCODING_UTF_8=y
CONFIG_FATFS_CODEPAGE_932=y
CONFIG_TINYUSB_CDC_ENABLED=y
```
